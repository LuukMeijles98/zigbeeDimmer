## CMakeLists.txt
```
#-------------------------------------------------------------------------------
# Zephyr Example Application
#
# Copyright (c) 2021 Nordic Semiconductor ASA
# SPDX-License-Identifier: Apache-2.0

cmake_minimum_required(VERSION 3.13.1)
find_package(Zephyr REQUIRED HINTS $ENV{ZEPHYR_BASE})

project(app LANGUAGES C)

target_sources(app PRIVATE src/leds.c
        src/main.c
)
```

## sample.yaml
```
# This file is provided so that the application can be compiled using Twister,
# the Zephyr testing tool. In this file, multiple combinations can be specified,
# so that you can easily test all of them locally or in CI.
sample:
  description: Example application
  name: example-application 
common:
  build_only: true
  integration_platforms:
    - custom_plank
    - nucleo_f302r8
    - zigbeeDimmer
tests:
  app.default: {}
  app.debug:
    extra_overlay_confs:
      - debug.conf
```

## prj.conf
```kconfig
# Copyright (c) 2021 Nordic Semiconductor ASA
# SPDX-License-Identifier: Apache-2.0
#
# This file contains selected Kconfig options for the application.

CONFIG_GPIO=y
CONFIG_STDOUT_CONSOLE=y
CONFIG_PRINTK=y
CONFIG_COUNTER=y
CONFIG_PWM_SAM0_TCC=y
CONFIG_PWM=y
CONFIG_LOG=y
CONFIG_LOG_PRINTK=y
CONFIG_SPI=y

#CONFIG_TEST_RANDOM_GENERATOR=y
#CONFIG_ENTROPY_SAM_RNG=y
#CONFIG_ENTROPY_GENERATOR=y
#CONFIG_ENTROPY_DEVICE_RANDOM_GENERATOR=y

CONFIG_NETWORKING=y
#CONFIG_NET_PKT_TX_COUNT=4
#CONFIG_NET_BUF_DATA_SIZE=128
CONFIG_NET_SOCKETS=y
CONFIG_NET_SOCKETS_PACKET=y
CONFIG_NET_SOCKETS_POSIX_NAMES=n

CONFIG_NET_L2_IEEE802154=y
CONFIG_NET_L2_IEEE802154_RFD=y
CONFIG_NET_L2_IEEE802154_SHELL=y
#CONFIG_IEEE802154_DRIVER_LOG_LEVEL_DBG=y

CONFIG_NET_CONFIG_SETTINGS=y
CONFIG_NET_CONFIG_IEEE802154_RADIO_TX_POWER=5
CONFIG_NET_LOG=y
```

## src/main.c
```c
/*
 * Copyright (c) 2021 Nordic Semiconductor ASA
 * SPDX-License-Identifier: Apache-2.0
 */

#include <stdio.h>
#include <app_version.h>
#include <zephyr/kernel.h>
#include <zephyr/sys/printk.h>
#include <zephyr/device.h>
#include <zephyr/net/buf.h>
#include <zephyr/net/ieee802154_radio.h>
#include <zephyr/net/ieee802154_mgmt.h>
#include <zephyr/net/ethernet.h>
#include <zephyr/net/socket.h>

#include <zephyr/logging/log.h>
LOG_MODULE_REGISTER(main, CONFIG_APP_LOG_LEVEL);

#define TEST_PAYLOAD "test"

/* led functions */
extern int configLeds(void);
extern void toggleLed(struct k_timer *dummy);
extern int setPwm(uint32_t pwm_ds);

K_TIMER_DEFINE(dbg_led_timer, toggleLed, NULL);

#if IS_ENABLED(CONFIG_NET_TC_THREAD_COOPERATIVE)
#define THREAD_PRIORITY K_PRIO_COOP(CONFIG_NUM_COOP_PRIORITIES -1)
#else
#define THREAD_PRIORITY K_PRIO_PREEMPT(8)
#endif

/*
 *  Stack for the tx thread
 */
static K_THREAD_STACK_DEFINE(tx_stack, 1024);
static struct k_thread tx_thread_data;

static void tx_thread(void){
	int ret;

	struct net_if *iface = net_if_get_ieee802154();

	while(1){
		struct net_pkt *pkt;

		pkt = net_pkt_alloc_with_buffer(iface, sizeof(TEST_PAYLOAD), AF_UNSPEC, 0, K_NO_WAIT);

		if(pkt == NULL){
			printk("Unable to allocate packet");
		}

		ret = net_pkt_write(pkt, TEST_PAYLOAD, sizeof(TEST_PAYLOAD));
		if(ret < 0){
			printk("Unable to write! Err: %i\n", ret);
		}

		ret = net_send_data(pkt);
		if(ret < 0){
			printk("Unable to send! Err %i\n", ret);
		}

		net_pkt_unref(pkt);

		
		k_msleep(1000);
	}
}

int main(void){
	int ret;
	struct zsock_pollfd fds;
	struct sockaddr_ll socket_ssl = {0};

	printk("Starting led dimmer\n");

	if(!configLeds()){
		printk("An error occured while configuring the LEDs\n");
		return 0;
	}

	struct net_if *iface = net_if_get_ieee802154();
	if(iface == NULL){
		printk("Unable to get 802.15.4 interface.");
	}
	
	k_timer_start(&dbg_led_timer, K_SECONDS(1), K_SECONDS(1));

	/* enable recieving */
	fds.fd = zsock_socket(AF_PACKET, SOCK_DGRAM, ETH_P_IEEE802154);
	if(fds.fd < 0){
		printk("Failed to create RAW socket. Err %i\n", errno);
		return 0;
	}

	fds.events = ZSOCK_POLLIN;

	socket_ssl.sll_ifindex = net_if_get_by_iface(iface);
	socket_ssl.sll_family = AF_PACKET;
	socket_ssl.sll_protocol = ETH_P_IEEE802154;

	if(zsock_bind(fds.fd, (const struct sockaddr *)&socket_ssl, sizeof(struct sockaddr_ll))){
		printk("Failed to bind packet socket. Err %i\n", errno);
		return 0;
	}

	/* Start TX thread */
	k_thread_create(&tx_thread_data, tx_stack, K_THREAD_STACK_SIZEOF(tx_stack), (k_thread_entry_t)tx_thread, NULL, NULL, NULL, THREAD_PRIORITY, 0, K_NO_WAIT);

	while (1) {
		uint8_t buf[256];

		ret = zsock_poll(&fds, 1, 1000);
		if(ret == 0){
			continue;
		}
		else if(ret < 0){
			printk("Unable to poll radio! Err %i\n", ret);
			break;
		}

		ret = zsock_recv(fds.fd, buf, sizeof(buf), 0);
		if(ret > 0){
			printk("%i bytes recieved!\n", ret);
			printk("buff = %s\n", buf);
		}
		else{
			printk("Unable to recieve data from radio! Err %i\n", ret);
		}
	}

	return 0;
}
```

## src/leds.c
```c
#include <math.h>
#include <zephyr/kernel.h>
#include <zephyr/sys/printk.h>
#include <zephyr/device.h>
#include <zephyr/drivers/gpio.h>
#include <zephyr/drivers/pwm.h>


#define PWM_PERIOD 20000

static const struct gpio_dt_spec led0 = GPIO_DT_SPEC_GET(DT_ALIAS(led0), gpios);
static const struct pwm_dt_spec pwm_led0 = PWM_DT_SPEC_GET(DT_ALIAS(pwm_led0));

int configLeds(void){
	if (!gpio_is_ready_dt(&led0)) {
		printk("Error: DBG led is not ready");
		return 0;
	}

	if (!pwm_is_ready_dt(&pwm_led0)) {
		printk("Error: PWM device %s is not ready\n",
		       pwm_led0.dev->name);
		return 0;
	}

	int ret;

	ret = gpio_pin_configure_dt(&led0, GPIO_OUTPUT_ACTIVE);
	if (ret < 0) {
		return 0;
	}

	ret = pwm_set_dt(&pwm_led0, PWM_PERIOD, PWM_PERIOD / 2U);
	if (ret) {
		printk("Error %d: failed to set pulse width\n", ret);
		return 0;
	}

	printk("PWM channel = %u\n", pwm_led0.channel);
	printk("PWM period = %u\n", pwm_led0.period);
	printk("PWM flags = %u\n", pwm_led0.flags);

	return 1;
}

void toggleLed(struct k_timer *dummy){
		int ret = gpio_pin_toggle_dt(&led0);
		if (ret < 0) {
            printk("Error: Cant toggle debug led\n");
		}
}

int setPwm(uint32_t pwm_ds){
    int ret;
	uint32_t pwm_pulse;
    pwm_pulse = (unsigned) round((PWM_PERIOD * pwm_ds)/100);
    ret = pwm_set_cycles(pwm_led0.dev, pwm_led0.channel, PWM_PERIOD, pwm_pulse, pwm_led0.flags);
    if(ret){
        printk("Error %d: failed to set pulse width\n", ret);
        return 0;
    }
    return 1;
}
```
