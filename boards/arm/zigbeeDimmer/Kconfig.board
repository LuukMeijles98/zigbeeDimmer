## boards/arm/zigbeeDimmer/Kconfig.board
```kconfig
# SAM L21 Xplained Pro board configuration

# Copyright (c) 2021 Argentum Systems Ltd.
# SPDX-License-Identifier: Apache-2.0

config BOARD_ZIGBEEDIMMER
	bool "zigbeedimmer"
	depends on SOC_PART_NUMBER_SAMR30E18A
```

## boards/arm/zigbeeDimmer/zigbeeDimmer_defconfig
```kconfig
# Copyright (c) 2021 Argentum Systems Ltd.
# SPDX-License-Identifier: Apache-2.0

CONFIG_SOC_SERIES_SAMR30=y
CONFIG_SOC_PART_NUMBER_SAMR30E18A=y
CONFIG_SOC_ATMEL_SAML_OSC32K=y
CONFIG_SOC_ATMEL_SAML_OSC32K_AS_MAIN=y
CONFIG_BOARD_ZIGBEEDIMMER=y
CONFIG_BUILD_OUTPUT_HEX=y

CONFIG_CONSOLE=y
CONFIG_GPIO=y
CONFIG_SERIAL=y
CONFIG_UART_CONSOLE=y
CONFIG_UART_INTERRUPT_DRIVEN=y

#CONFIG_SOC_ATMEL_SAML_OSC16M=y
#CONFIG_SOC_ATMEL_SAML_OSC16M_AS_MAIN=y
```
